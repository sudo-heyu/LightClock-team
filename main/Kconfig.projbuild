## main/Kconfig.projbuild
```kconfig
menu "Light Wake-up Alarm (BLE)"

    config LIGHT_ALARM_ALWAYS_ON
        bool "Always on: keep awake + always BLE advertising"
        default y
        help
            When enabled, the firmware will not enter deep sleep and will keep
            BLE advertising running continuously (GAP advertising).
            This is intended for debugging and development.

    config LIGHT_ALARM_DEBUG_DISABLE_DEEP_SLEEP
        bool "Debug: disable deep sleep (keep serial/USB alive)"
        default y
        help
            When enabled, the firmware will not enter deep sleep.
            This is useful while using idf_monitor on ESP32-C3 where deep sleep
            can make the COM port disappear on the host.
            Disable this option for normal low-power behavior.

    config LIGHT_ALARM_CH455_INTENSITY
        int "CH455 brightness level (0=max, 7=7/8)"
        range 0 7
        default 0

    config LIGHT_ALARM_TIME_SHOW_SECONDS
        int "Short-press time display duration (seconds)"
        range 5 120
        default 10

    config LIGHT_ALARM_DEBUG_BAT_ADC_EN_ALWAYS_HIGH
        bool "Debug: keep BAT_ADC_EN high"
        default n
        help
            When enabled, BAT_ADC_EN (GPIO21) is kept at high level all the time.
            This is useful for debugging battery voltage measurement on boards
            where the divider is gated by BAT_ADC_EN.
            When disabled, BAT_ADC_EN is only asserted during sampling.

    config LIGHT_ALARM_GRADIENT_MINUTES
        int "Alarm sunrise gradient duration (minutes)"
        range 5 60
        default 30

endmenu
```
